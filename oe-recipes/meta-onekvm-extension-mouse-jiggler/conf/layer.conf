## oe-recipes/meta-onekvm-extension-mouse-jiggler/conf/layer.conf
```bitbake
BBPATH .= ":${LAYERDIR}"

BBFILES += "${LAYERDIR}/recipes-*/*/*.bb \
            ${LAYERDIR}/recipes-*/*/*.bbappend"

BBFILE_COLLECTIONS += "onekvm-extension-mouse-jiggler"
BBFILE_PATTERN_onekvm-extension-mouse-jiggler := "^${LAYERDIR}/"
BBFILE_PRIORITY_onekvm-extension-mouse-jiggler = "8"

LAYERDEPENDS_onekvm-extension-mouse-jiggler = "core onekvm"
LAYERSERIES_COMPAT_onekvm-extension-mouse-jiggler = "wrynose"
```
